## app/project/Kconfig.tmp
```kconfig
source "/Volumes/TB/yunlong_github/my_xiaozhi-sf32/sdk/customer/boards/sf32lb52-lcd_n16r8/hcpu/Kconfig.board"
source "$SIFLI_SDK/customer/boards/Kconfig.v2"
source "$SIFLI_SDK/Kconfig.v2"
orsource "sf-pkgs/Kconfig.conandeps"
rsource "Kconfig.proj"
```
