## app/boards/sf32lb52-xty-ai/hcpu/Kconfig.board
```kconfig
config BSP_USING_BOARD_SF32LB52_XTY_AI
    bool
    select SOC_SF32LB52X
    select BF0_HCPU
    default y

config LOW_POWER_NO_SHUTDOWN
    bool "low power dont shutdown"
	default y  
rsource "../Kconfig.board"
```

## app/boards/sf32lb52-xty-ai_base/Kconfig.board
```kconfig
config ASIC
    bool 
    default y 
   
config TOUCH_IRQ_PIN
    int
    default 41

config LCD_PWM_BACKLIGHT_INTERFACE_NAME
    string
    default "pwm2"

config LCD_PWM_BACKLIGHT_CHANEL_NUM
    int
    default 4

config LCD_BACKLIGHT_CONTROL_PIN
    int
    default 1
    
config RGBLED_CONTROL_PIN
    int
    default 32  

config PA_EN_LEVEL
    bool "Set to true if the PA level is high when the PA_EN pin is high."
    default y

config PA_EN_PIN
    int "The pin number for the PA_EN control."
    default 26


# LCD configuration
if !BSP_USING_BUILTIN_LCD && BF0_HCPU
    config LCD_USING_ST7789
        bool
        default y

    choice
        prompt "Built-in LCD module driver"
        default LCD_USING_SPI_ST7789

        config LCD_USING_SPI_ST7789
            bool "1.69 rect SPI LCD(240x280)"
            select LCD_USING_ST7789
            select BSP_LCDC_USING_SPI_DCX_1DATA

    endchoice

    config LCD_HOR_RES_MAX
        int
        default 280 if LCD_USING_SPI_ST7789


    config LCD_VER_RES_MAX
        int
        default 240 if LCD_USING_SPI_ST7789


    config LCD_DPI
        int
        default 320 if LCD_USING_SPI_ST7789

endif
```

## app/project/Kconfig.proj
```kconfig
#APP specific configuration.
config BF0_HCPU
    bool
    default y

config CUSTOM_MEM_MAP
    bool 
	select custom_mem_map
	default y    

config XIAOZHI_USING_MQTT
    bool "xiaozhi_using_mqtt"
	default n

config CONFIG_IOT_PROTOCOL_MCP
    bool "using mcp protocol"
	default y 

comment "------------Project configuration-----------"



config BLUETOOTH_NAME
    string "Bluetooth device name"
    default "sifli-pan"
    help
        Specify the Bluetooth device name for the application.

config BT_NAME_MAC_ENABLE
    bool "Append the MAC address to the Bluetooth name"
    default n
    help
        Append the MAC address to the Bluetooth name, such as "sifli-pan-12:34:56:78:9a:bc".

# 选择字体文件和路径
menu "Font configuration"
    config FONT_FILE
        string "Font file path"
        default "font/DroidSansFallback.ttf"
        help
            Specify the path to the font file used in the application.
endmenu

# KWS
config KWS_ENABLE_DEFAULT
    bool "Enable KWS by default"
    default n
    help
        Enable KWS (Keyword Spotting) by default in the application. 
```
